## main/Kconfig.projbuild
```kconfig
menu "ESP-PIX Configuration"

    config ESP_PIX_WIFI_SSID
        string "WiFi SSID"
        default "EDILMA_2.5"
        help
            SSID (network name) for the PIX device to connect to.

    config ESP_PIX_WIFI_PASSWORD
        string "WiFi Password"
        default "password"
        help
            WiFi password (WPA or WPA2) for the PIX device.

    config ESP_PIX_BACKEND_URL
        string "Backend URL"
        default "https://localhost:3000/api"
        help
            Backend API URL for PIX payments (HTTPS required).

    config ESP_PIX_LED_GPIO
        int "LED GPIO"
        default 2
        help
            GPIO pin for status LED.

    config ESP_PIX_BUTTON_GPIO
        int "Button GPIO"
        default 4
        help
            GPIO pin for button input.

    config ESP_PIX_BUZZER_GPIO
        int "Buzzer GPIO"
        default 15
        help
            GPIO pin for buzzer.

    config ESP_PIX_SERVO_GPIO
        int "Servo GPIO"
        default 13
        help
            GPIO pin for servo motor.

    config ESP_PIX_TFT_CS_GPIO
        int "TFT CS GPIO"
        default 5
        help
            GPIO pin for TFT chip select.

    config ESP_PIX_TFT_DC_GPIO
        int "TFT DC GPIO"
        default 16
        help
            GPIO pin for TFT data/command.

    config ESP_PIX_TFT_RST_GPIO
        int "TFT Reset GPIO"
        default 17
        help
            GPIO pin for TFT reset.

    config ESP_PIX_TFT_MOSI_GPIO
        int "TFT MOSI GPIO"
        default 23
        help
            GPIO pin for SPI MOSI.

    config ESP_PIX_TFT_SCK_GPIO
        int "TFT SCK GPIO"
        default 18
        help
            GPIO pin for SPI clock.

    config ESP_PIX_PAYMENT_TIMEOUT_MS
        int "Payment Timeout (ms)"
        default 60000
        help
            Timeout in milliseconds for QR code payment.

endmenu
```

## sdkconfig.defaults
```kconfig
# ESP-PIX Default Configuration for ESP-IDF 5.5.0

# Target
CONFIG_IDF_TARGET="esp32"

# WiFi Configuration
CONFIG_ESP_PIX_WIFI_SSID="EDILMA_2.5"
CONFIG_ESP_PIX_WIFI_PASSWORD="password"

# Backend Configuration
CONFIG_ESP_PIX_BACKEND_URL="http://localhost:3000/api"
CONFIG_ESP_PIX_BACKEND_URL_SSL="https://localhost:3000/api"

# GPIO Configuration
CONFIG_ESP_PIX_LED_GPIO=2
CONFIG_ESP_PIX_BUTTON_GPIO=4
CONFIG_ESP_PIX_BUZZER_GPIO=15
CONFIG_ESP_PIX_SERVO_GPIO=13
CONFIG_ESP_PIX_TFT_CS_GPIO=5
CONFIG_ESP_PIX_TFT_DC_GPIO=16
CONFIG_ESP_PIX_TFT_RST_GPIO=17
CONFIG_ESP_PIX_TFT_MOSI_GPIO=23
CONFIG_ESP_PIX_TFT_SCK_GPIO=18

# Payment Configuration
CONFIG_ESP_PIX_PAYMENT_TIMEOUT_MS=60000

# FreeRTOS
CONFIG_FREERTOS_HZ=1000

# WiFi
CONFIG_ESP_WIFI_STATIC_RX_BUFFER_NUM=10
CONFIG_ESP_WIFI_DYNAMIC_RX_BUFFER_NUM=32
CONFIG_ESP_WIFI_DYNAMIC_TX_BUFFER_NUM=32

# HTTP Client
CONFIG_ESP_HTTP_CLIENT_ENABLE_HTTPS=y

# Partition table
CONFIG_PARTITION_TABLE_SINGLE_APP=y

# Log level
CONFIG_LOG_DEFAULT_LEVEL_INFO=y
CONFIG_LOG_DEFAULT_LEVEL=3

# Optimize for performance
CONFIG_COMPILER_OPTIMIZATION_PERF=y

# LWIP
CONFIG_LWIP_MAX_SOCKETS=10
```
